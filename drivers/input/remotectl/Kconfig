## drivers/input/remotectl/Kconfig
```kconfig
# SPDX-License-Identifier: GPL-2.0
#
# Input remotectl driver configuration
#
menuconfig ROCKCHIP_REMOTECTL
	tristate "rockchip remotectl"
	default n
	help
	  Say Y here, will suport rk remotectl.
	  This option doesn't affect the kernel.
	  If unsure, say Y.

if ROCKCHIP_REMOTECTL

config ROCKCHIP_REMOTECTL_PWM
	tristate "rockchip remoctrl pwm capture"
	default n

config RK_IR_NO_DEEP_SLEEP
    bool "rk_pwm-remoctrl no Deep Sleep"
    depends on ROCKCHIP_REMOTECTL_PWM
    default y

endif
```
